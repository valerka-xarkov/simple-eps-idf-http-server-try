## main/Kconfig.projbuild
```kconfig
menu "Wifi Auth Configuration"

    config ESP_WIFI_SSID
        string "WiFi SSID"
        default "myssid"

    config ESP_WIFI_PASSWORD
        string "WiFi Password"
        default "mypassword"

    config ESP_MAXIMUM_RETRY
        int "Maximum retry"
        default 5
        help
            Set the Maximum retry to avoid station reconnecting to the AP unlimited when the AP is really inexistent.
endmenu

menu "Time configuration"

    config SNTP_TIME_SERVER
        string "time.windows.com"
        default "pool.ntp.org"
        help
            Hostname of the main SNTP server.
endmenu

menu "IP Address Configuration"
    
    config STATIC_IP_ADDR
        string "Static IP address"
        default "192.168.1.111"

    config STATIC_NETMASK_ADDR
        string "Static netmask address"
        default "255.255.255.0"

    config STATIC_GW_ADDR
        string "Static gateway address"
        default "192.168.1.1"

    config STATIC_DNS_SERVER_MAIN
        string "Main DNS server address"
        default "192.168.1.1"
endmenu
```

## sdkconfig.defaults
```kconfig
CONFIG_SNTP_TIME_SERVER="time.windows.com"
CONFIG_ESP_DEFAULT_CPU_FREQ_MHZ_240=y
CONFIG_ESP_DEFAULT_CPU_FREQ_MHZ=240
#CONFIG_MONITOR_BAUD=115200
#CONFIG_MONITOR_BAUD=460800
#CONFIG_ESP_CONSOLE_UART_BAUDRATE=460800

CONFIG_ESPTOOLPY_FLASHMODE_QOUT=y
CONFIG_ESPTOOLPY_FLASHFREQ_80M=y

CONFIG_ESPTOOLPY_FLASHFREQ="80m"
CONFIG_ESPTOOLPY_FLASHSIZE_16MB=y
CONFIG_PARTITION_TABLE_CUSTOM=y
CONFIG_PARTITION_TABLE_CUSTOM_FILENAME="partitions.csv"
CONFIG_FATFS_LFN_HEAP=y


CONFIG_LWIP_TCP_SND_BUF_DEFAULT=20440
CONFIG_LWIP_TCP_WND_DEFAULT=20440
CONFIG_LWIP_TCP_RECVMBOX_SIZE=16

CONFIG_LWIP_MAX_UDP_PCBS=16
CONFIG_LWIP_UDP_RECVMBOX_SIZE=16

CONFIG_ESP_MAXIMUM_RETRY=200
CONFIG_COMPILER_OPTIMIZATION_PERF=y
CONFIG_BOOTLOADER_COMPILER_OPTIMIZATION_PERF=y

CONFIG_LWIP_TCP_MSS=1460
CONFIG_TCP_MSS=1460
CONFIG_LWIP_SNTP_UPDATE_DELAY=86400000
#CONFIG_FLASHMODE_QOUT=y
CONFIG_FLASHMODE_QIO=y
CONFIG_ESPTOOLPY_FLASHMODE_QIO=y


CONFIG_ESP_WIFI_NVS_ENABLED=n
CONFIG_OPTIMIZATION_LEVEL_DEBUG=n
CONFIG_COMPILER_OPTIMIZATION_LEVEL_DEBUG=n
CONFIG_COMPILER_OPTIMIZATION_DEFAULT=n
CONFIG_ESP_PHY_CALIBRATION_AND_DATA_STORAGE=n
CONFIG_ESP32_PHY_CALIBRATION_AND_DATA_STORAGE=n

CONFIG_LWIP_TCPIP_TASK_PRIO=24
CONFIG_ESP32_WIFI_AMPDU_TX_ENABLED=y
CONFIG_ESP_PHY_IRAM_OPT=y
CONFIG_ESP_WIFI_IRAM_OPT=y
CONFIG_ESP_WIFI_EXTRA_IRAM_OPT=y
CONFIG_ESP_WIFI_RX_IRAM_OPT=y
CONFIG_ESP_WIFI_SLP_IRAM_OPT=y
CONFIG_LWIP_IRAM_OPTIMIZATION=y
CONFIG_LWIP_EXTRA_IRAM_OPTIMIZATION=y

CONFIG_ESP_WIFI_DYNAMIC_TX_BUFFER_NUM=64


CONFIG_SPIRAM=y
CONFIG_SPIRAM_MODE_OCT=y
CONFIG_SPIRAM_SPEED_80M=y
CONFIG_SPIRAM_SPEED=80
CONFIG_SPIRAM_ALLOW_BSS_SEG_EXTERNAL_MEMORY=n
```
